## components/nightglass_services/Kconfig
```kconfig
menu "Nightglass audio"

config NIGHTGLASS_AUDIO_ENABLED
    bool "Enable audio input/output"
    default y
    help
        Enable the supervised ES8311/ES7210 diagnostic surface. The Audio app
        provides explicit bounded playback and microphone tests; no recording
        is stored or transmitted. Boot only arms the service with the PA gate
        low. Codec, I2S DMA, microphones, and the one-shot worker exist only
        during a user-initiated test. Disable this to omit the service.

config NIGHTGLASS_AUDIO_BOOT_SELF_TEST
    bool "Run one audio hardware self-test after boot"
    depends on NIGHTGLASS_AUDIO_ENABLED
    default n
    help
        Queue one bounded microphone capture followed by one bounded speaker
        tone after the normal Nightglass shell reaches ready state. Results
        are emitted to the serial log and no captured samples are retained.
        This is a bench/HIL gate only and must remain disabled in production.

endmenu
```

## components/nightglass_update/Kconfig
```kconfig
menu "Nightglass update and recovery"

config NIGHTGLASS_OTA_ENABLED
    bool "Enable the OTA update backend"
    default y
    help
        Build the inactive-slot streaming update backend and boot recovery
        supervisor. This does not provide a network or companion transport.

config NIGHTGLASS_OTA_ALLOW_UNSIGNED_DEVELOPMENT
    bool "DEVELOPMENT ONLY: accept unsigned OTA manifests"
    depends on NIGHTGLASS_OTA_ENABLED
    default n
    help
        Permit an update only when the signature verifier reports that no
        verifier is installed. A rejected signature is never bypassed. This
        setting is unsafe for distributed firmware and must remain disabled
        for production. Snapshots and logs explicitly identify this mode as
        unsigned development, never as signature verified.

config NIGHTGLASS_OTA_P256_PUBLIC_KEY_HEX
    string "Provisioned OTA ECDSA P-256 public key (SEC1 hex)"
    depends on NIGHTGLASS_OTA_ENABLED
    default ""
    help
        Uncompressed SEC1 P-256 public key encoded as exactly 130 hexadecimal
        characters (04 || X || Y). The private signing key must never be placed
        in firmware or this repository. An empty value installs no verifier;
        malformed configured values install a rejecting sentinel. Both states
        fail closed before slot erase.

config NIGHTGLASS_OTA_HIL_FORCE_HEALTH_FAILURE
    bool "HIL ONLY: force the OTA essential-health gate to fail"
    depends on NIGHTGLASS_OTA_ENABLED
    default n
    help
        Build a uniquely versioned signed rollback-test image whose sixty-second
        essential-health gate must reject the pending slot. Production release
        verification refuses any resolved configuration with this enabled.

endmenu
```
